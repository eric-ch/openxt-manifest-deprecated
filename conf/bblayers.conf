## conf/bblayers.conf
```bitbake
# LAYER_CONF_VERSION is increased each time conf/bblayers.conf changes
# incompatibly

LCONF_VERSION = "7"

BBPATH = "${TOPDIR}"
BBFILES ?= ""
BBLAYERS ?= " \
  ${TOPDIR}/repos/openembedded-core/meta \
  ${TOPDIR}/repos/meta-openembedded/meta-oe \
  "
```

## conf/local.conf
```bitbake
# CONF_VERSION is increased each time conf/ changes incompatibly
CONF_VERSION = "1"

#INHERIT += "rm_work"

# Which files do we want to parse:
BBMASK = ""

# What kind of images do we want?
IMAGE_FSTYPES_append = " tar.xz"

# Set DEPLOY_DIR outside of TMPDIR
DEPLOY_DIR = "${TMPDIR}/../deploy/${TCLIBC}"

# Don't generate the mirror tarball for SCM repos, the snapshot is enough
BB_GENERATE_MIRROR_TARBALLS = "0"

#
# Parallelism Options
#
# These two options control how much parallelism BitBake should use.
# The first option determines how many tasks bitbake should run in parallel:
# Default to setting automatically based on cpu count
BB_NUMBER_THREADS ?= "${@oe.utils.cpu_count()}"
#
# The second option controls how many processes make should run in parallel
# when running compile tasks:
# Default to setting automatically based on cpu count
PARALLEL_MAKE ?= "-j ${@oe.utils.cpu_count()}"


#
# Shared-state files from other locations
#
# Shared state files are prebuilt cache data objects which can used to
# accelerate build time. This variable can be used to configure the system to
# search other mirror locations for these objects before it builds the data
# itself.
#
# This can be a filesystem directory, or a remote url such as http or ftp.
# These would contain the sstate-cache results from previous builds (possibly
# from other machines). This variable works like fetcher MIRRORS/PREMIRRORS
# and points to the cache locations to check for the shared objects.
#SSTATE_MIRRORS ?= "\
#file://.* http://someserver.tld/share/sstate/ \n \
#file://.* file:///some/local/dir/sstate/"

#SSTATE_MIRRORS ?= "\
#file://.* http://dominion.thruhere.net/angstrom/sstate-mirror/ \n "

# enable PR service on build machine itself its good for a case when this is
# the only builder generating the feeds
#
PRSERV_HOST = "localhost:0"

# TODO: This should not be in local.conf
#       Probably belongs to something equivalent to bitbake.conf (defines
#       KERNELORG_SOURCE, etc), but that one cannot be extended it seems.
XEN_VERSION="4.6.6"
XEN_SRC_URI="https://downloads.xenproject.org/release/xen/4.6.6/xen-4.6.6.tar.gz"
XEN_SRC_MD5SUM="698328dcac775c8ccef0da3167020b19"
XEN_SRC_SHA256SUM="fa0748f128b189ec3497470a95f53ea42bbe4d7b5622509bcd862877895842f8"

# TODO: This probably belongs to the xenclient-oe layer.
REPO_PROD_CACERT="${OPENXT_CERTS_DIR}/prod-cacert.pem"
REPO_DEV_CACERT="${OPENXT_CERTS_DIR}/dev-cacert.pem"
REPO_DEV_SIGNING_CERT="${OPENXT_CERTS_DIR}/dev-cacert.pem"
REPO_DEV_SIGNING_DEV="${OPENXT_CERTS_DIR}/dev-cakey.pem"

### COMPLETE HACK, that should be in the distro config.
# Prefer openssl over libressl
PREFERRED_PROVIDER_openssl = "openssl"
PREFERRED_PROVIDER_openssl-native = "openssl-native"
PREFERRED_PROVIDER_libcrypto = "libcrypto"
PREFERRED_PROVIDER_libssl = "libssl"
PREFERRED_PROVIDER_openssl-conf = "openssl-conf"
PREFERRED_PROVIDER_nativesdk-openssl = "nativesdk-openssl"
PREFERRED_PROVIDER_nativesdk-openssl-conf = "nativesdk-openssl-conf"

PREFERRED_PROVIDER_console-tools = "console-tools"
PREFERRED_PROVIDER_virtual/libx11 = "libx11"

### XXX: Why is that not anywhere in the OCaml & findlib class/.inc
SYSROOT_OCAML_PATH = "${STAGING_DIR_NATIVE}${libdir_native}/${TRANSLATED_TARGET_ARCH}${TARGET_VENDOR}-${TARGET_OS}/ocaml"
export OCAML_STDLIBDIR = "${SYSROOT_OCAML_PATH}/site-lib"
OCAML_HEADERS = "${SYSROOT_OCAML_PATH}"
export ocamllibdir = "${libdir}/ocaml"
export STAGING_LIBDIR_OCAML = "${STAGING_LIBDIR}/ocaml"
OCAML_FINDLIB_CONF = "${STAGING_DIR_HOST}${sysconfdir}/findlib.conf"

### XXX: Why is that not anywhere in the rpcgen class/.inc
STAGING_IDLDIR = "${STAGING_DATADIR}/idl"

# Should be changed for remote feed.
XENCLIENT_PACKAGE_FEED_URI ?= "file:///storage/ipk"

# Downloads needed for OpenXT build. Optionally replace with a local mirror.
OPENXT_MIRROR="http://mirror.openxt.org"

# xenclient-feed-configs. It requires a bunch of things:
XENCLIENT_BUILD = "devbuild"
XENCLIENT_BUILD_DATE = "00:00:00 01/01/01"
XENCLIENT_BUILD_BRANCH = "master"
```
